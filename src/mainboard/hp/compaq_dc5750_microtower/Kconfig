## src/mainboard/hp/compaq_dc5750_microtower/Kconfig
```kconfig
if BOARD_HP_COMPAQ_DC5750_MICROTOWER_PC

config BOARD_SPECIFIC_OPTIONS
	def_bool y
	select BOARD_ROMSIZE_KB_8192
	select HAVE_ACPI_RESUME
	select HAVE_ACPI_TABLES
	select INTEL_INT15
	select NORTHBRIDGE_AMD_RS485
	select SERIRQ_CONTINUOUS_MODE
	select SOUTHBRIDGE_AMD_SB600
	select USE_NATIVE_RAMINIT
	select MEMORY_MAPPED_TPM
	select MAINBOARD_HAS_TPM1
	select HAVE_OPTION_TABLE
	select HAVE_CMOS_DEFAULT
	select SUPERIO_SMSC_SCH5327B_NS
	select MAINBOARD_HAS_LIBGFXINIT
	select INTEL_GMA_HAVE_VBT
	select MAINBOARD_USES_IFD_GBE_REGION

config CBFS_SIZE
	default 0x2F0000

config MAINBOARD_DIR
	default "hp/compaq_dc5750_microtower"

config MAINBOARD_PART_NUMBER
	default "HP Compaq DC5750 MicroTower PC"

config DRAM_RESET_GATE_GPIO
	int
	default 60

config USBDEBUG_HCD_INDEX
	int
	default 2
endif
```
